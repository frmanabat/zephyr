## drivers/sensor/adi/max86178/Kconfig
```kconfig
# MAX86178 Optical Sensor

# Copyright (c) 2026 Analog Devices, Inc.
# SPDX-License-Identifier: Apache-2.0

config MAX86178
	bool "MAX86178 Optical Sensor"
	default y
	depends on DT_HAS_ADI_MAX86178_ENABLED
	select I2C if $(dt_compat_on_bus,$(DT_COMPAT_ADI_MAX86178),i2c)
	select SPI if $(dt_compat_on_bus,$(DT_COMPAT_ADI_MAX86178),spi)
	help
	    Enable driver for MAX86178 Optical Sensor.

if MAX86178

choice MAX86178_TRIGGER_MODE
	prompt "Trigger mode"
	default MAX86178_TRIGGER_NONE
	help
	  Specify the type of triggering used by the driver.

config MAX86178_TRIGGER_NONE
	bool "No trigger"

config MAX86178_TRIGGER_GLOBAL_THREAD
	bool "Use global thread"
	select GPIO
	select MAX86178_TRIGGER

config MAX86178_TRIGGER_OWN_THREAD
	bool "Use own thread"
	select GPIO
	select MAX86178_TRIGGER
endchoice

config MAX86178_TRIGGER
	bool

config MAX86178_THREAD_PRIORITY
	int "Thread priority"
	depends on MAX86178_TRIGGER_OWN_THREAD && MAX86178_TRIGGER
	default 10
	help
	  Priority of thread used by the driver to handle interrupts.

config MAX86178_THREAD_STACK_SIZE
	int "Thread stack size"
	depends on MAX86178_TRIGGER_OWN_THREAD && MAX86178_TRIGGER
	default 4096
	help
	  Stack size of thread used by the driver to handle interrupts.

config MAX86178_INIT_PRIORITY
	int "Initialization priority"
	default SENSOR_INIT_PRIORITY
	help
	  Initialization priority of the MAX86178 driver. Should be lower than the priority of any
	  thread that needs to use the driver.

config MAX86178_STREAM
	bool "Use streaming mode"
	select MAX86178_TRIGGER
	select SPI_RTIO if $(dt_compat_on_bus,$(DT_COMPAT_ADI_MAX86178),spi)
	select I2C_RTIO if $(dt_compat_on_bus,$(DT_COMPAT_ADI_MAX86178),i2c)
	select SENSOR_ASYNC_API
	help
	  Use this configuration option to enable streaming sensor data via RTIO.

endif # MAX86178
```

## dts/bindings/sensor/adi,max86178-i2c.yaml
```yaml
# Copyright (c) 2026 Analog Devices Inc.
# SPDX-License-Identifier: Apache-2.0

description: MAX86178 multi-sensor AFE with I2C interface

compatible: "adi,max86178"

include: ["i2c-device.yaml", "adi,max86178-common.yaml"]
```

## dts/bindings/sensor/adi,max86178-spi.yaml
```yaml
# Copyright (c) 2026 Analog Devices Inc.
# SPDX-License-Identifier: Apache-2.0

description: MAX86178 Optical AFE with SPI interface

# compatible: "adi,max86178"

include: ["spi-device.yaml", "adi,max86178-common.yaml"]
```
